// vim: set ts=2 sw=2 ft=devicetree:

/*
 * Copyright (c) 2024 The ZMK Contributors
 *
 * SPDX-License-Identifier: MIT
 */

#include <dt-bindings/zmk/keys.h>

/ {
	behaviors {
		/omit-if-no-ref/ num_word: num_word {
			compatible = "zmk,behavior-num-word";
			#binding-cells = <0>;
			// layers = <xx>; // to be specified in user config using "&num_word { layers = <xx>; };"
			continue-list = <BACKSPACE DELETE DOT COMMA>;
			ignore-numbers;
		};
	};
};


